## boards/shields/horizon/Kconfig.shield
```kconfig
# Copyright (c) 2020 The ZMK Contributors
# SPDX-License-Identifier: MIT

config SHIELD_horizon_dongle_display
    def_bool $(shields_list_contains,horizon_dongle_display)

config SHIELD_horizon_with
    def_bool $(shields_list_contains,horizon)
    
config SHIELD_horizon_without
    def_bool $(shields_list_contains,horizon_without)
```

## config/boards/shields/cygnus/Kconfig.shield
```kconfig
# Copyright (c) 2020 The ZMK Contributors
# SPDX-License-Identifier: MIT

config SHIELD_cygnus_central_dongle
    def_bool $(shields_list_contains,cygnus_central_dongle)

config SHIELD_cygnus_central_left
    def_bool $(shields_list_contains,cygnus_central_left)
    
config SHIELD_horizon_PERIPHERAL_LEFT
    def_bool $(shields_list_contains,horizon_peripheral_left)
```

## config/west.yml
```yaml
manifest:
  remotes:
    - name: zmkfirmware
      url-base: https://github.com/petejohanson
    - name: inorichi
      url-base: https://github.com/inorichi
    - name: zmkfirmware
      url-base: https://github.com/zmkfirmware      
  projects:
    - name: zmk
      remote: zmkfirmware
      revision: feat/pointers-move-scroll
      import: app/west.yml
    - name: zmk
      remote: zmkfirmware
      revision: v0.3
      import: app/west.yml
    - name: zmk-dongle-display
      remote: englmaxi
      revision: main      
  self:
    path: config
    
```
